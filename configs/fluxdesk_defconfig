## configs/fluxdesk_defconfig
```kconfig
BR2_CCACHE=y
BR2_TOOLCHAIN_BUILDROOT_WCHAR=y
BR2_TOOLCHAIN_BUILDROOT_CXX=y
BR2_INIT_SYSV=y
BR2_ROOTFS_DEVICE_CREATION_DYNAMIC_EUDEV=y
BR2_ROOTFS_OVERLAY="board/fluxdesk"
BR2_LINUX_KERNEL=y
BR2_LINUX_KERNEL_DEFCONFIG="i386"
BR2_PACKAGE_XORG7=y
BR2_PACKAGE_XSERVER_XORG_SERVER=y
BR2_PACKAGE_XAPP_XCLOCK=y
BR2_PACKAGE_XAPP_XEYES=y
BR2_PACKAGE_XAPP_XHOST=y
BR2_PACKAGE_XAPP_XINIT=y
BR2_PACKAGE_XAPP_XINPUT=y
BR2_PACKAGE_XDRIVER_XF86_INPUT_EVDEV=y
BR2_PACKAGE_XDRIVER_XF86_INPUT_KEYBOARD=y
BR2_PACKAGE_XDRIVER_XF86_INPUT_MOUSE=y
BR2_PACKAGE_XDRIVER_XF86_VIDEO_VESA=y
BR2_PACKAGE_XSCREENSAVER=y
BR2_PACKAGE_XTERM=y
BR2_PACKAGE_FLUXBOX=y
BR2_TARGET_ROOTFS_CPIO_BZIP2=y
BR2_TARGET_ROOTFS_ISO9660=y
# BR2_TARGET_ROOTFS_TAR is not set
BR2_TARGET_GRUB=y
BR2_PACKAGE_HOST_MKE2IMG=y
```

## configs/muen.arm64_defconfig
```kconfig
BR2_aarch64=y
BR2_CCACHE=y
BR2_TARGET_GENERIC_HOSTNAME="muen"
BR2_TARGET_GENERIC_ISSUE="Welcome to MuenOnARM"
BR2_TARGET_GENERIC_ROOT_PASSWD="root"
BR2_SYSTEM_BIN_SH_BASH=y
BR2_TARGET_GENERIC_GETTY_PORT="ttyPS0"
BR2_TARGET_GENERIC_GETTY_BAUDRATE_115200=y
BR2_ROOTFS_OVERLAY="board/muen.arm64/rootfs-additions"
BR2_PACKAGE_BUSYBOX_SHOW_OTHERS=y
BR2_PACKAGE_HAVEGED=y
BR2_PACKAGE_ETHTOOL=y
BR2_PACKAGE_IFUPDOWN=y
BR2_PACKAGE_IPERF3=y
BR2_PACKAGE_OPENSSH=y
BR2_PACKAGE_TCPDUMP=y
BR2_PACKAGE_SYSKLOGD=y
BR2_TARGET_ROOTFS_CPIO=y
BR2_TARGET_ROOTFS_CPIO_GZIP=y
# BR2_TARGET_ROOTFS_TAR is not set
```

## configs/muen_defconfig
```kconfig
BR2_x86_64=y
BR2_CCACHE=y
BR2_TOOLCHAIN_BUILDROOT_WCHAR=y
BR2_TOOLCHAIN_BUILDROOT_CXX=y
BR2_TARGET_GENERIC_HOSTNAME="muen-linux"
BR2_TARGET_GENERIC_ISSUE="Welcome to Linux on Muen SK"
BR2_ROOTFS_DEVICE_CREATION_DYNAMIC_MDEV=y
BR2_TARGET_GENERIC_ROOT_PASSWD="muen"
BR2_SYSTEM_BIN_SH_BASH=y
BR2_ROOTFS_OVERLAY="board/muen/rootfs-additions"
BR2_PACKAGE_BUSYBOX_CONFIG="board/muen/busybox.cfg"
BR2_PACKAGE_BUSYBOX_SHOW_OTHERS=y
BR2_PACKAGE_STRACE=y
BR2_PACKAGE_DOSFSTOOLS=y
BR2_PACKAGE_DOSFSTOOLS_FSCK_FAT=y
BR2_PACKAGE_DOSFSTOOLS_MKFS_FAT=y
BR2_PACKAGE_E2FSPROGS=y
BR2_PACKAGE_CRYPTSETUP=y
BR2_PACKAGE_PCIUTILS=y
BR2_PACKAGE_SYSSTAT=y
BR2_PACKAGE_LIBNL=y
BR2_PACKAGE_BRIDGE_UTILS=y
BR2_PACKAGE_ETHTOOL=y
BR2_PACKAGE_IFUPDOWN=y
BR2_PACKAGE_IPERF=y
BR2_PACKAGE_IPROUTE2=y
BR2_PACKAGE_IPTABLES=y
BR2_PACKAGE_OPENSSH=y
BR2_PACKAGE_TCPDUMP=y
BR2_PACKAGE_FILE=y
BR2_PACKAGE_SCREEN=y
BR2_PACKAGE_KMOD=y
BR2_PACKAGE_UTIL_LINUX_SCHEDUTILS=y
BR2_PACKAGE_MINGETTY=y
BR2_PACKAGE_TTYSNOOP=y
BR2_PACKAGE_VTTEST=y
BR2_PACKAGE_PINGPONG=y
BR2_PACKAGE_SYSBENCH=y
BR2_PACKAGE_MUENFS=y
BR2_PACKAGE_MUENNET=y
BR2_TARGET_ROOTFS_CPIO=y
BR2_TARGET_ROOTFS_CPIO_GZIP=y
# BR2_TARGET_ROOTFS_TAR is not set
```

## package/ioquake3/Config.in
```kconfig
config BR2_PACKAGE_IOQUAKE3
	bool "ioquake3"
	depends on BR2_PACKAGE_HAS_LIBGL # libglu
	depends on BR2_PACKAGE_OPENAL_ARCH_SUPPORTS
	depends on BR2_PACKAGE_XORG7 # SDL2 OpenGL (GLX)
	depends on BR2_USE_MMU # SDL2 OpenGL (GLX)
	depends on !BR2_STATIC_LIBS # SDL2
	select BR2_PACKAGE_JPEG
	select BR2_PACKAGE_LIBGLU
	select BR2_PACKAGE_LIBPNG
	select BR2_PACKAGE_OPENAL
	select BR2_PACKAGE_SDL2
	select BR2_PACKAGE_SDL2_OPENGL
	select BR2_PACKAGE_ZLIB
	help
	  ioquake3 is a free software first person shooter engine based on the
	  Quake 3: Arena and Quake 3: Team Arena source code. The source code is
	  licensed under the GPL version 2, and was first released under that
	  license by id software on August 20th, 2005.

comment "ioquake3 needs X11 and a toolchain w/ C++, OpenGL backend, gcc >= 4.7, NPTL, dynamic library"
	depends on BR2_PACKAGE_OPENAL_ARCH_SUPPORTS
	depends on BR2_PACKAGE_XORG7
	depends on BR2_USE_MMU
	depends on !BR2_INSTALL_LIBSTDCPP || !BR2_PACKAGE_HAS_LIBGL || \
		!BR2_TOOLCHAIN_GCC_AT_LEAST_4_7 || !BR2_TOOLCHAIN_HAS_THREADS_NPTL || \
		BR2_STATIC_LIBS
```

## package/muen/lmods/Config.in
```kconfig
config BR2_PACKAGE_LMODS
	bool "Muen Linux modules"
	help
	  Prepare the Muen-specific Linux kernel headers for external module
	  builds.
```

## package/muen/mingetty/Config.in
```kconfig
config BR2_PACKAGE_MINGETTY
	bool "mingetty"
	help
	  Small Linux console getty that is started on the Linux text console, asks
	  for a login name and then tranfers over to /bin/login. Is extended to
	  allow automatic login and starting any app.
```

## package/muen/muenblock/Config.in
```kconfig
config BR2_PACKAGE_MUENBLOCK
	bool "muenblock"
	depends on BR2_PACKAGE_LMODS
	help
	  The muenblock Linux kernel module implements a block device driver which
	  transports block I/O requests (bio) via Muen shared memory channels.
```

## package/muen/muenfs/Config.in
```kconfig
config BR2_PACKAGE_MUENFS
	bool "muenfs"
	depends on BR2_PACKAGE_MUEN_LINUX_MODULES
	help
	  The muenfs Linux kernel module facilitates user-space access to Muen
	  shared memory channels by exporting them in a virtual file system.
```

## package/muen/muennet/Config.in
```kconfig
config BR2_PACKAGE_MUENNET
	bool "muennet"
	depends on BR2_PACKAGE_LIBNL
	help
	  The muennet_cfg tool allows management of muennet interfaces, such as
	  addition of child devices.
```

## package/muen/pingpong/Config.in
```kconfig
config BR2_PACKAGE_PINGPONG
	bool "pingpong"
	help
	  Tool to measure SM emulation round-trips.
```

## package/muen/sysbench/Config.in
```kconfig
config BR2_PACKAGE_SYSBENCH
	bool "sysbench"
	help
	  SysBench is a modular, cross-platform and multi-threaded benchmark tool
	  for evaluating OS parameters that are important for a system running a
	  database under intensive load.
```

## package/muen/ttysnoop/Config.in
```kconfig
config BR2_PACKAGE_TTYSNOOP
	bool "ttysnoop"
	help
	  Allows you to spy on telnet+serial connections.
	  Used to link tty0 with hvc0.
```

## package/muen/vttest/Config.in
```kconfig
config BR2_PACKAGE_VTTEST
	bool "vttest"
	help
	  Vttest tests the compatibility of so-called "VT100-compatible" terminals.
```
