## configs/muen.arm64-qemu_defconfig
```kconfig
BR2_aarch64=y
BR2_TOOLCHAIN_BUILDROOT_MUSL=y
BR2_CCACHE=y
BR2_STATIC_LIBS=y
BR2_TARGET_GENERIC_HOSTNAME="muen"
BR2_TARGET_GENERIC_ISSUE="Welcome to MuenOnARM"
BR2_TARGET_GENERIC_ROOT_PASSWD="root"
BR2_SYSTEM_BIN_SH_BASH=y
BR2_TARGET_GENERIC_GETTY_PORT="ttyPS0"
BR2_TARGET_GENERIC_GETTY_BAUDRATE_115200=y
BR2_ROOTFS_OVERLAY="board/muen/rootfs-additions/common board/muen/rootfs-additions/arm64"
BR2_PACKAGE_BUSYBOX_SHOW_OTHERS=y
BR2_PACKAGE_DOSFSTOOLS=y
BR2_PACKAGE_DOSFSTOOLS_FSCK_FAT=y
BR2_PACKAGE_DOSFSTOOLS_MKFS_FAT=y
BR2_PACKAGE_E2FSPROGS=y
BR2_PACKAGE_LIBNL=y
BR2_PACKAGE_HAVEGED=y
BR2_PACKAGE_ETHTOOL=y
BR2_PACKAGE_IFUPDOWN=y
BR2_PACKAGE_IPERF3=y
BR2_PACKAGE_IPTABLES=y
BR2_PACKAGE_OPENSSH=y
BR2_PACKAGE_TCPDUMP=y
BR2_PACKAGE_SCREEN=y
BR2_PACKAGE_SYSKLOGD=y
BR2_PACKAGE_MUENFS=y
BR2_PACKAGE_MUENNET=y
BR2_TARGET_ROOTFS_CPIO=y
BR2_TARGET_ROOTFS_CPIO_GZIP=y
# BR2_TARGET_ROOTFS_TAR is not set
```

## package/muen/ttyrun/Config.in
```kconfig
config BR2_PACKAGE_TTYRUN
	bool "ttyrun"
	help
	  Start a program if a specified terminal device is available.
	  Standalone utility extracted from s390-tools.
```
